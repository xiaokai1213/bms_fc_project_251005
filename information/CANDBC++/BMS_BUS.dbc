VERSION ""

NS_ :

BS_:

BU_:

BO_ 3221225472 VECTOR__INDEPENDENT_SIG_MSG: 0 Vector__XXX
 SG_ pack_2_cell_vol_01 : 0|16@1+ (1,0) [0|65535] "mv" Vector__XXX
 SG_ pack_2_cell_vol_02 : 0|16@1+ (1,0) [0|65535] "mv" Vector__XXX
 SG_ pack_2_cell_vol_03 : 0|16@1+ (1,0) [0|65535] "mv" Vector__XXX
 SG_ pack_2_cell_vol_04 : 0|16@1+ (1,0) [0|65535] "mv" Vector__XXX
 SG_ pack_2_cell_vol_05 : 0|16@1+ (1,0) [0|65535] "mv" Vector__XXX
 SG_ pack_2_cell_vol_06 : 0|16@1+ (1,0) [0|65535] "mv" Vector__XXX
 SG_ pack_2_cell_vol_07 : 0|16@1+ (1,0) [0|65535] "mv" Vector__XXX
 SG_ pack_2_cell_vol_08 : 0|16@1+ (1,0) [0|65535] "mv" Vector__XXX
 SG_ pack_2_cell_vol_09 : 0|16@1+ (1,0) [0|65535] "mv" Vector__XXX
 SG_ pack_2_cell_vol_10 : 0|16@1+ (1,0) [0|65535] "mv" Vector__XXX
 SG_ pack_2_cell_vol_11 : 0|16@1+ (1,0) [0|65535] "mv" Vector__XXX
 SG_ pack_2_cell_vol_12 : 0|16@1+ (1,0) [0|65535] "mv" Vector__XXX
 SG_ pack_2_cell_vol_13 : 0|16@1+ (1,0) [0|65535] "mv" Vector__XXX
 SG_ pack_2_cell_vol_14 : 0|16@1+ (1,0) [0|65535] "mv" Vector__XXX
 SG_ pack_2_cell_vol_15 : 0|16@1+ (1,0) [0|65535] "mv" Vector__XXX
 SG_ pack_2_cell_vol_16 : 0|16@1+ (1,0) [0|65535] "mv" Vector__XXX
 SG_ pack_2_cell_vol_17 : 0|16@1+ (1,0) [0|65535] "mv" Vector__XXX
 SG_ pack_2_cell_vol_18 : 0|16@1+ (1,0) [0|65535] "mv" Vector__XXX
 SG_ pack_2_cell_vol_19 : 0|16@1+ (1,0) [0|65535] "mv" Vector__XXX
 SG_ pack_2_cell_vol_20 : 0|16@1+ (1,0) [0|65535] "mv" Vector__XXX
 SG_ pack_3_cell_vol_01 : 0|16@1+ (1,0) [0|65535] "mv" Vector__XXX
 SG_ pack_3_cell_vol_02 : 0|16@1+ (1,0) [0|65535] "mv" Vector__XXX
 SG_ pack_3_cell_vol_03 : 0|16@1+ (1,0) [0|65535] "mv" Vector__XXX
 SG_ pack_3_cell_vol_04 : 0|16@1+ (1,0) [0|65535] "mv" Vector__XXX
 SG_ pack_3_cell_vol_05 : 0|16@1+ (1,0) [0|65535] "mv" Vector__XXX
 SG_ pack_3_cell_vol_06 : 0|16@1+ (1,0) [0|65535] "mv" Vector__XXX
 SG_ pack_3_cell_vol_07 : 0|16@1+ (1,0) [0|65535] "mv" Vector__XXX
 SG_ pack_3_cell_vol_08 : 0|16@1+ (1,0) [0|65535] "mv" Vector__XXX
 SG_ pack_3_cell_vol_09 : 0|16@1+ (1,0) [0|65535] "mv" Vector__XXX
 SG_ pack_3_cell_vol_10 : 0|16@1+ (1,0) [0|65535] "mv" Vector__XXX
 SG_ pack_3_cell_vol_11 : 0|16@1+ (1,0) [0|65535] "mv" Vector__XXX
 SG_ pack_3_cell_vol_12 : 0|16@1+ (1,0) [0|65535] "mv" Vector__XXX
 SG_ pack_3_cell_vol_13 : 0|16@1+ (1,0) [0|65535] "mv" Vector__XXX
 SG_ pack_3_cell_vol_14 : 0|16@1+ (1,0) [0|65535] "mv" Vector__XXX
 SG_ pack_3_cell_vol_15 : 0|16@1+ (1,0) [0|65535] "mv" Vector__XXX
 SG_ pack_3_cell_vol_16 : 0|16@1+ (1,0) [0|65535] "mv" Vector__XXX
 SG_ pack_3_cell_vol_17 : 0|16@1+ (1,0) [0|65535] "mv" Vector__XXX
 SG_ pack_3_cell_vol_18 : 0|16@1+ (1,0) [0|65535] "mv" Vector__XXX
 SG_ pack_3_cell_vol_19 : 0|16@1+ (1,0) [0|65535] "mv" Vector__XXX
 SG_ pack_3_cell_vol_20 : 0|16@1+ (1,0) [0|65535] "mv" Vector__XXX
 SG_ pack_1_cell_vol_20 : 0|16@1+ (1,0) [0|65535] "mv" Vector__XXX
 SG_ pack_1_cell_vol_19 : 0|16@1+ (1,0) [0|65535] "mv" Vector__XXX
 SG_ pack_1_cell_vol_18 : 0|16@1+ (1,0) [0|65535] "mv" Vector__XXX
 SG_ pack_1_cell_vol_17 : 0|16@1+ (1,0) [0|65535] "mv" Vector__XXX
 SG_ pack_1_cell_vol_16 : 0|16@1+ (1,0) [0|65535] "mv" Vector__XXX
 SG_ pack_1_cell_vol_15 : 0|16@1+ (1,0) [0|65535] "mv" Vector__XXX
 SG_ pack_1_cell_vol_14 : 0|16@1+ (1,0) [0|65535] "mv" Vector__XXX
 SG_ pack_1_cell_vol_13 : 0|16@1+ (1,0) [0|65535] "mv" Vector__XXX
 SG_ pack_1_cell_vol_12 : 0|16@1+ (1,0) [0|65535] "mv" Vector__XXX
 SG_ pack_1_cell_vol_11 : 0|16@1+ (1,0) [0|65535] "mv" Vector__XXX
 SG_ pack_1_cell_vol_10 : 0|16@1+ (1,0) [0|65535] "mv" Vector__XXX
 SG_ pack_1_cell_vol_09 : 0|16@1+ (1,0) [0|65535] "mv" Vector__XXX
 SG_ pack_1_cell_vol_08 : 0|16@1+ (1,0) [0|65535] "mv" Vector__XXX
 SG_ pack_1_cell_vol_07 : 0|16@1+ (1,0) [0|65535] "mv" Vector__XXX
 SG_ pack_1_cell_vol_06 : 0|16@1+ (1,0) [0|65535] "mv" Vector__XXX
 SG_ pack_1_cell_vol_05 : 0|16@1+ (1,0) [0|65535] "mv" Vector__XXX
 SG_ pack_1_cell_vol_04 : 0|16@1+ (1,0) [0|65535] "mv" Vector__XXX
 SG_ pack_1_cell_vol_03 : 0|16@1+ (1,0) [0|65535] "mv" Vector__XXX
 SG_ pack_1_cell_vol_02 : 0|16@1+ (1,0) [0|65535] "mv" Vector__XXX
 SG_ pack_1_cell_vol_01 : 0|16@1+ (1,0) [0|65535] "mv" Vector__XXX

BO_ 2165688671 pack_1_cv_05_to_08: 0 Vector__XXX

BO_ 2165588670 pack_1_cv_01_to_04: 0 Vector__XXX

CM_ BO_ 3221225472 "This is a message for not used signals, created by Vector CANdb++ DBC OLE DB Provider.";
CM_ SG_ 3221225472 pack_1_cell_vol_02 "1号电池组02号电芯的电压值";
CM_ SG_ 3221225472 pack_1_cell_vol_01 "1号电池组01号电芯的电压值";
BA_DEF_ SG_  "GenSigSendType" ENUM  "Cyclic","OnWrite","OnWriteWithRepetition","OnChange","OnChangeWithRepetition","IfActive","IfActiveWithRepetition","NoSigSendType";
BA_DEF_ BO_  "GenMsgSendType" ENUM  "Cyclic","not_used","not_used","not_used","not_used","Cyclic","not_used","IfActive","NoMsgSendType";
BA_DEF_  "DBName" STRING ;
BA_DEF_  "BusType" STRING ;
BA_DEF_DEF_  "GenSigSendType" "Cyclic";
BA_DEF_DEF_  "GenMsgSendType" "NoMsgSendType";
BA_DEF_DEF_  "DBName" "";
BA_DEF_DEF_  "BusType" "CAN";
BA_ "DBName" "BMS_BUS";
